// AUTO-GENERATED by packages/client/scripts/gen-script-globals.ts.
// Do not edit by hand. Source of truth: script-globals-types.ts.

interface ReadOnlyComponentView {
    readonly state: Readonly<Record<string, unknown>>;
}

type Listener = (payload: unknown) => void;

type SeatIndex = number;

type AssetType = 'image' | 'model' | 'sound';

interface AssetEntry {
    readonly slug: string;
    readonly name: string;
    readonly type: AssetType;
    readonly url: string;
    readonly preload: boolean;
    readonly description?: string;
    readonly tags?: readonly string[];
}

declare class AssetsApi {
  get(slug: string): AssetEntry | null;
  list(opts?: { type?: AssetType }): ReadonlyArray<AssetEntry>;
}

type ShapeKind = 'rect' | 'circle';

type ImageFit = 'fit' | 'cover' | 'stretch' | 'none';

interface ShapeOpts {
    kind?: ShapeKind;
    fill?: string;
    stroke?: string;
    strokeWidth?: number;
    radius?: number;
}

type StickerFace = 'top' | 'bottom' | 'front' | 'back' | 'left' | 'right';

interface StickerOpts {
    face: StickerFace;
    size?: [
        number,
        number
    ];
    offset?: number;
    canvasSize?: [
        number,
        number
    ];
    content: {
        shape: ShapeOpts & {
            kind: ShapeKind;
        };
    } | {
        image: string;
        fit?: ImageFit;
    } | {
        html: string;
    };
}

declare class EntityFacade {
  readonly id: string;
  readonly type: string;
  readonly name: string;
  readonly owner: SeatIndex | null;
  readonly tags: string[];
  getComponent(typeId: string): ReadOnlyComponentView | undefined;
  addEventListener(event: string, cb: Listener): void;
  removeEventListener(event: string, cb: Listener): void;
  setValue(value: string): void;
  setData(key: string, value: string): void;
  getData(key: string): string | undefined;
  deleteData(key: string): boolean;
  setHtml(html: string): void;
  setImageRef(ref: string): void;
  setShape(opts: ShapeOpts): void;
  setBounds(x: number, y: number, w: number, h: number): void;
}

declare class SceneFacade {
  readonly assets: AssetsApi;
  getObjectById(id: string): EntityFacade | undefined;
  getTable(): EntityFacade | undefined;
  getObjectsByTag(tag: string): EntityFacade[];
  playSound(slug: string): void;
  attachSticker(parent: EntityFacade, opts: StickerOpts): EntityFacade | null;
}

declare class Game {
  onSceneInitialised(scene: SceneFacade): void;
  onScriptLoaded(scene: SceneFacade): void;
}

declare global {
  var scene: SceneFacade;
  var Game: typeof Game;
  var console: Pick<Console, 'log' | 'error' | 'warn' | 'info' | 'debug'>;
}
